## esp-idf/app/main/Kconfig.projbuild
```kconfig
menu "Example Configuration"

     config ESP_WIFI_STA_RETRY_ATTEMPTS
     	    int "Station Attempts"
	    default 5
	    help
		Number of attempts the ESP (as a station) to connect to external WiFi AP.
endmenu
```

## esp-idf/blink/main/Kconfig.projbuild
```kconfig
menu "Example Configuration"
     config ESP_WIFI_SSID
     	    string "WiFi SSID"
	    default "esp_ssid"
	    help
		SSID (Network name) for the device to connect to.

     config ESP_WIFI_PASSWORD
     	    string "WiFi Password"
	    default "password"
	    help
		WiFi Password (WPA or WPA2) for the example to use.

     config ESP_WIFI_CHANNEL
     	    int "WiFi Channel"
	    range 1 13
	    default 1
	    help
		WiFi channel for the example to use.

     config ESP_MAX_STA_CONN
     	    int "Max STA connections"
	    default 4
	    help
		Max number of the STA connections to AP.
endmenu
```

## esp-idf/hcsr04/main/Kconfig.projbuild
```kconfig
menu "Access Point"
     config ESP_WIFI_AP_SSID
     	    string "WiFi Access Point SSID"
	    default "ESP32C6_SSID"
	    help
		SSID (Network name) for the Access Point to create.

     config ESP_WIFI_AP_PASSWORD
     	    string "WiFi Password"
	    default "password"
	    help
		WiFi Password (WPA or WPA2) for connecting to the AP.

     config ESP_WIFI_AP_MAX_CONNECTIONS
     	    int "Maximum connections"
	    default 5
	    help
		Maximum allowed stations for connecting to the AP.
     		
     config ESP_WIFI_AP_CHANNEL
     	    int "WiFi Channel"
     	    range 1 13 
	    default 1
	    help
		WiFi channel for the AP.
endmenu

menu "Station"
     config ESP_WIFI_STA_RETRY_ATTEMPTS
     	    int "Station Attempts"
	    default 5
	    help
		Number of attempts the ESP (as a station) to connect to external WiFi AP.
endmenu

menu "MQTT"
     config MQTT_BROKER_URI
     	    string "Mqtt brokers uri including port"
	    default "mqtt://77.237.242.215:1883"
	    help
		Mqtt broker uri string.

     config MQTT_CLIENT_ID
     	    string "Mqtt client id string"
	    default "esp32c6Client"
	    help
		Mqtt client id string.

     config MQTT_CLIENT_USERNAME
     	    string "Mqtt client username."
	    default "chris"
	    help
		Mqtt client username.

     config MQTT_CLIENT_PASSWORD
     	    string "Mqtt client password."
	    default "chris"
	    help
		Mqtt client password.
endmenu

menu "HCSR04" 
     config TRIGGER_PIN
     	    int "Trigger Pin Number"
	    default 8
	    help
		Trigger Pin to emit ultrasonic pulses
		
     config ECHO_PIN
     	    int "Echo Pin Number"
	    default 10
	    help
		Echo Pin to receive ultrasonic echo pulses
endmenu

menu "LM35"

endmenu
```
